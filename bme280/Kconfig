## bme280/Kconfig
```kconfig
menuconfig MY_SENSOR
    bool "Driver BME280"
    select SENSOR_ASYNC_API
    help
      Active le driver BME280 utilisant Read and Decode
      pour mesurer la temperature, la pression et humidite.
```

## bme280/dts/bindings/sensor/bosch,my-bme280.yaml
```yaml
description: Capteur Bosch BME280 de temperature, pression et humidite pour le TP
compatible: "bosch,my-bme280"
include: [sensor-device.yaml, i2c-device.yaml]
```

## bme280/dts/bindings/sensor/bosh,my-bme280.yaml
```yaml
description: Capteur de temperature BME280

compatible: "bosch,my-bme280"

include : [sensor-device.yaml, i2c-device.yaml]
```

## dummy_driver/Kconfig
```kconfig
config MY_SENSOR
    bool "Capteur de temperature simule"
    default y
    select SENSOR
    select SENSOR_ASYNC_API
    help
      Active le driver du capteur simule utilisant Read and Decode.

if MY_SENSOR

config MY_SENSOR_STEP_MC
    int "Increment de temperature en millicelsius"
    range 0 10000
    default 250
    help
      Increment applique entre deux lectures.
      Utiliser 0 pour obtenir une temperature constante.

endif
```

## dummy_driver/dts/bindings/sensor/zephyr,tp-sensor.yaml
```yaml
# dts/bindings/sensor/<vendor>,<device>.yaml

compatible: "zephyr,tp-sensor"
include: [sensor-device.yaml]




properties:

  initial-millicelsius:
    type: int
    default: 0
    description: Initial_val_mcelsius

  maximum-millicelsius:
    type: int
    default: 0
    description: Max_val_mcelsius
```
